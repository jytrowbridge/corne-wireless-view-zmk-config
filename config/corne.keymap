/*
 * Copyright (c) 2020 The ZMK Contributors
 *
 * SPDX-License-Identifier: MIT
 */

#include <behaviors.dtsi>
#include <behaviors/num_word.dtsi>
#include <dt-bindings/zmk/keys.h>
#include <dt-bindings/zmk/bt.h>
#include <dt-bindings/zmk/pointing.h>

#include "zmk-helpers/helper.h"
#include "zmk-helpers/key-labels/42.h"
#include "misc.dtsi"

#define XXX &none
#define ___ &trans

#define DEF 0
#define NAV 1
#define NUM 2
#define MED 3
#define FUN 4
#define MOU 5
#define SYS 6
#define WSP 7
// damn. need function and media
// #define MOUSE 5


/* Global defaults */

#define QUICK_TAP_MS 175

&sk {
  release-after-ms = <900>;
  quick-release;
};

&sl { // Allow sticky mods to chord across sticky layers.
  ignore-modifiers;
};

&lt {
  flavor = "balanced";
  tapping-term-ms = <200>;
  quick-tap-ms = <QUICK_TAP_MS>;
};


// Tap: esc | double-tap: caps word | Hold: shift
#define ESC_SHIFT &esc_shift LSHFT 0
ZMK_HOLD_TAP(esc_shift, bindings = <&kp>, <&shift_dance>; flavor = "balanced"; tapping-term-ms = <200>; quick-tap-ms = <QUICK_TAP_MS>;)
ZMK_TAP_DANCE(shift_dance, bindings = <&kp ESC>, <&caps_word>;
              tapping-term-ms = <200>;)


#define SMART_NUM &smart_num NUM 0
ZMK_HOLD_TAP(smart_num, bindings = <&mo>, <&num_dance>; flavor = "balanced";
             tapping-term-ms = <200>; quick-tap-ms = <QUICK_TAP_MS>;)
ZMK_TAP_DANCE(num_dance, bindings = <&num_word NUM>, <&sl NUM>;
              tapping-term-ms = <200>;)

ZMK_TRI_STATE(
    smart_mouse, bindings = <&tog MOU>, <&none>, <&tog MOU>;
    ignored-key-positions =
        <LM1 LM2 LM3 LM4 RT1 RT2 RT3 RT4 RM1 RM2 RM3 RM4 RB1 RB2 RB3>;
    ignored-layers = <MOU NAV FUN>;)

/* Homerow mods */

#define KEYS_L LT0 LT1 LT2 LT3 LT4 LT5 LM0 LM1 LM2 LM3 LM4 LM5 LB0 LB1 LB2 LB3 LB4 LB5
#define KEYS_R RT0 RT1 RT2 RT3 RT4 RT5 RM0 RM1 RM2 RM3 RM4 RM5 RB0 RB1 RB2 RB3 RB4 RB5
#define THUMBS LH2 LH1 LH0 RH0 RH1 RH2
#define _PASSTHRU_ROW_ ___ ___ ___ ___ ___ ___
#define _PASSTHRU_THUMBS_ ___ ___ ___

#define MAKE_HRM(NAME, HOLD, TAP, TRIGGER_POS)                                 \
  ZMK_HOLD_TAP(NAME, bindings = <HOLD>, <TAP>; flavor = "balanced";            \
               tapping-term-ms = <280>; quick-tap-ms = <QUICK_TAP_MS>;         \
               require-prior-idle-ms = <150>; hold-trigger-on-release;         \
               hold-trigger-key-positions = <TRIGGER_POS>;)

MAKE_HRM(hml, &kp, &kp, KEYS_R THUMBS) // Left-hand HRMs.
MAKE_HRM(hmr, &kp, &kp, KEYS_L THUMBS) // Right-hand HRMs.

// Hack: Make HRM combos tap-only (cf, ZMK issue #544).
#define ZMK_COMBO_8(NAME, TAP, POS, LAYERS, COMBO_MS, IDLE_MS, HOLD, SIDE)     \
  MAKE_HRM(hm_combo_##NAME, &kp, TAP, SIDE THUMBS)                             \
  ZMK_COMBO_6(NAME, &hm_combo_##NAME HOLD 0, POS, LAYERS, COMBO_MS, IDLE_MS)


// must be included after hrm combo mod
#include "combos.dtsi"

#define SIMPLE_MORPH(NAME, MOD, BINDING1, BINDING2)                            \
  ZMK_MOD_MORPH(NAME, mods = <(MOD_L##MOD | MOD_R##MOD)>;                      \
                bindings = <BINDING1>, <BINDING2>;)

// Tap: comma | Shift + tap: semicolon | Ctrl + shift + tap: <.
SIMPLE_MORPH(comma_morph, SFT, &kp COMMA, &comma_inner_morph)
SIMPLE_MORPH(comma_inner_morph, CTL, &kp SEMICOLON, &kp LESS_THAN)

// Tap: dot | Shift + tap: colon | Ctrl + shift + tap: >.
SIMPLE_MORPH(dot_morph, SFT, &kp DOT, &dot_inner_morph)
SIMPLE_MORPH(dot_inner_morph, CTL, &kp COLON, &kp GREATER_THAN)

// Tap: qmark | Shift + tap: excl.
SIMPLE_MORPH(qexcl, SFT, &kp QMARK, &kp EXCL)

#define PWSP &kp LC(LG(LEFT))
#define NWSP &kp LC(LG(RIGHT))
#define COPY &kp LC(INS)
#define CUT &kp LC(X)
#define PASTE &kp LS(INS)

/ {
    conditional_layers {
        compatible = "zmk,conditional-layers";
        workspace_layer {
            if-layers = <NAV NUM>;
            then-layer = <WSP>;
        };

        sys_layer {
            if-layers = <NAV MED>;
            then-layer = <SYS>;
        };
    };
};

/* Layers */

ZMK_LAYER(Base,
//     ╭─────────────┬─────────────┬─────────────┬─────────────┬─────────────┬─────────────╮ ╭─────────────┬─────────────┬─────────────┬─────────────┬─────────────┬─────────────╮
         &mswap        &kp Q         &kp W         &kp F         &kp P         &kp B           &kp J         &kp L         &kp U         &kp Y         &kp BSPC      &kp DEL      
//     ├─────────────├─────────────┼─────────────┼─────────────┼─────────────┼─────────────┤ ├─────────────┼─────────────┼─────────────┼─────────────┼─────────────┼─────────────┤
         &kp LA(TAB)   &hml LGUI A   &hml LALT R   &hml LSHFT S  &hml LCTRL T  &kp G           &kp M         &hmr RCTRL N  &hmr RSHFT E  &hmr RALT I   &hmr RGUI O   &kp SQT 
//     ├─────────────├─────────────┼─────────────┼─────────────┼─────────────┼─────────────┤ ├─────────────┼─────────────┼─────────────┼─────────────┼─────────────┼─────────────┤
         &smart_mouse   &kp Z         &kp X         &kp C         &kp D         &kp V           &kp K         &kp H         &comma_morph  &dot_morph    &qexcl        &kp LG(LS(P))     
//     ╰─────────────┴─────────────┴─────────────┼─────────────┼─────────────┼─────────────┤ ├─────────────┼─────────────┼─────────────┼─────────────┴─────────────┴─────────────╯
                                                   ESC_SHIFT     &lt NAV SPACE &lt MED TAB     &lt MED RET   &lt FUN BSPC   SMART_NUM
//                                               ╰─────────────┴─────────────┴─────────────╯ ╰─────────────┴─────────────┴─────────────╯
// esc on hold / sticky shift on tap / caps lock on double tap?
)

ZMK_LAYER(Nav,
//     ╭────────────┬──────────────┬─────────────┬─────────────┬─────────────┬─────────────╮ ╭─────────────┬─────────────┬─────────────┬─────────────┬─────────────┬─────────────╮
         ___           &kp END        PWSP         NWSP          &kp HOME        ___            ___           &kp HOME      &kp PG_DN     &kp PG_UP     &kp END       ___      
//     ├────────────┼──────────────┼─────────────┼─────────────┼─────────────┼─────────────┤ ├─────────────┼─────────────┼─────────────┼─────────────┼─────────────┼─────────────┤
         ___           &mt LGUI LEFT  &mt LALT DOWN &mt LSHFT UP &mt LCTRL RIGHT ___             ___           &kp LEFT      &kp DOWN      &kp UP        &kp RIGHT     ___
//     ├────────────┼──────────────┼─────────────┼─────────────┼─────────────┼─────────────┤ ├─────────────┼─────────────┼─────────────┼─────────────┼─────────────┼─────────────┤
         ___           ___           CUT           COPY          PASTE         ___             ___           PASTE         COPY          CUT           &kp INS       ___       
//     ╰────────────┼──────────────┼─────────────┴─────────────┼─────────────┼─────────────┤ ├─────────────┼─────────────┼─────────────┼─────────────┴─────────────┴─────────────╯
                                                   _PASSTHRU_THUMBS_                           _PASSTHRU_THUMBS_
//                                               ╰─────────────┴─────────────┴─────────────╯ ╰─────────────┴─────────────┴─────────────╯

)

ZMK_LAYER(Num, // todo add cancel
//     ╭────────────┬──────────────┬─────────────┬─────────────┬─────────────┬─────────────╮ ╭─────────────┬─────────────┬─────────────┬─────────────┬─────────────┬─────────────╮
         ___           ___           &kp N7        &kp N8        &kp N9         &kp PLUS       &kp MINUS     &kp N7        &kp N8        &kp N9         ___           ___
//     ├────────────┼──────────────┼─────────────┼─────────────┼─────────────┼─────────────┤ ├─────────────┼─────────────┼─────────────┼─────────────┼─────────────┼─────────────┤
         ___           &kp N0        &hml LALT N4  &hml LSHFT N5 &hml LCTRL N6  &kp EQUAL      &kp DOT       &hmr RALT N4  &hmr RSHFT N5 &hmr RCTRL N6  &kp N0        ___
//     ├────────────┼──────────────┼─────────────┼─────────────┼─────────────┼─────────────┤ ├─────────────┼─────────────┼─────────────┼─────────────┼─────────────┼─────────────┤
         ___           ___           &kp N1        &kp N2        &kp N3         &kp STAR       &kp FSLH      &kp N1        &kp N2        &kp N3         &kp DOT       ___       
//     ╰────────────┼──────────────┼─────────────┴─────────────┼─────────────┼─────────────┤ ├─────────────┼─────────────┼─────────────┼─────────────┴─────────────┴─────────────╯
                                                   _PASSTHRU_THUMBS_                           _PASSTHRU_THUMBS_
//                                               ╰─────────────┴─────────────┴─────────────╯ ╰─────────────┴─────────────┴─────────────╯

)


ZMK_LAYER(Med,
//     ╭────────────┬──────────────┬─────────────┬─────────────┬─────────────┬─────────────╮ ╭─────────────┬─────────────┬─────────────┬─────────────┬─────────────┬─────────────╮
         ___           ___           ___           &kp C_PREV    &kp C_NEXT     ___            ___           &kp C_NEXT    &kp C_PREV    ___           ___           ___      
//     ├────────────┼──────────────┼─────────────┼─────────────┼─────────────┼─────────────┤ ├─────────────┼─────────────┼─────────────┼─────────────┼─────────────┼─────────────┤
         ___           &kp C_MUTE    &kp C_VOL_DN  &kp C_VOL_UP  &kp C_PP       ___            ___           &kp C_PP      &kp C_VOL_UP  &kp C_VOL_DN  &kp C_MUTE    ___
//     ├────────────┼──────────────┼─────────────┼─────────────┼─────────────┼─────────────┤ ├─────────────┼─────────────┼─────────────┼─────────────┼─────────────┼─────────────┤
         _PASSTHRU_ROW_                                                                        _PASSTHRU_ROW_      
//     ╰────────────┼──────────────┼─────────────┴─────────────┼─────────────┼─────────────┤ ├─────────────┼─────────────┼─────────────┼─────────────┴─────────────┴─────────────╯
                                                   _PASSTHRU_THUMBS_                           _PASSTHRU_THUMBS_
//                                               ╰─────────────┴─────────────┴─────────────╯ ╰─────────────┴─────────────┴─────────────╯

)

ZMK_LAYER(Fun,
//     ╭────────────┬──────────────┬─────────────┬─────────────┬─────────────┬─────────────╮ ╭─────────────┬─────────────┬─────────────┬─────────────┬───────────┬─────────────╮
         ___           ___           &kp F7        &kp F8         &kp F9        &kp F10           &kp F10    &kp F7        &kp F8        &kp F9        ___        ___
//     ├────────────┼──────────────┼─────────────┼─────────────┼─────────────┼─────────────┤ ├─────────────┼─────────────┼─────────────┼─────────────┼───────────┼─────────────┤
         ___           ___           &hml LALT F4  &hml LSHFT F5  &hml LCTRL F6 &kp F11           &kp F11    &hmr RCTRL F4 &hmr RSHFT F5 &hmr RALT F6  ___        ___
//     ├────────────┼──────────────┼─────────────┼─────────────┼─────────────┼─────────────┤ ├─────────────┼─────────────┼─────────────┼─────────────┼───────────┼─────────────┤
         ___           ___           &kp F1        &kp F2         &kp F3        &kp F12           &kp F12    &kp F1        &kp F2        &kp F3        ___        ___             
//     ╰────────────┼──────────────┼─────────────┴─────────────┼─────────────┼─────────────┤ ├─────────────┼─────────────┼─────────────┼─────────────┴───────────┴─────────────╯
                                                   _PASSTHRU_THUMBS_                           _PASSTHRU_THUMBS_
//                                               ╰─────────────┴─────────────┴─────────────╯ ╰─────────────┴─────────────┴─────────────╯

)

#define U_MS_U &mmv MOVE_UP
#define U_MS_D &mmv MOVE_DOWN
#define U_MS_L &mmv MOVE_LEFT
#define U_MS_R &mmv MOVE_RIGHT
#define U_WH_U &msc SCRL_UP
#define U_WH_D &msc SCRL_DOWN
#define U_WH_L &msc SCRL_LEFT
#define U_WH_R &msc SCRL_RIGHT

ZMK_LAYER(Mouse,
//     ╭────────────┬──────────────┬─────────────┬─────────────┬─────────────┬─────────────╮ ╭─────────────┬─────────────┬─────────────┬─────────────┬─────────────┬─────────────╮
         _PASSTHRU_ROW_                                                                        ___            U_WH_L       U_WH_D        U_WH_U         U_WH_R        ___      
//     ├────────────┼──────────────┼─────────────┼─────────────┼─────────────┼─────────────┤ ├─────────────┼─────────────┼─────────────┼─────────────┼─────────────┼─────────────┤
         _PASSTHRU_ROW_                                                                        ___            U_MS_L       U_MS_D        U_MS_U         U_MS_R        ___
//     ├────────────┼──────────────┼─────────────┼─────────────┼─────────────┼─────────────┤ ├─────────────┼─────────────┼─────────────┼─────────────┼─────────────┼─────────────┤
         ___           ___           ___           ___           ___           ___             ___           &mkp LCLK     &mkp MCLK     &mkp RCLK      ___           ___
//     ╰────────────┼──────────────┼─────────────┴─────────────┼─────────────┼─────────────┤ ├─────────────┼─────────────┼─────────────┼─────────────┴─────────────┴─────────────╯
                                                   _PASSTHRU_THUMBS_                           _PASSTHRU_THUMBS_
//                                               ╰─────────────┴─────────────┴─────────────╯ ╰─────────────┴─────────────┴─────────────╯

)

ZMK_LAYER(Sys,
//     ╭────────────┬──────────────┬─────────────┬─────────────┬─────────────┬─────────────╮ ╭─────────────┬─────────────┬─────────────┬─────────────┬─────────────┬─────────────╮
         &bt BT_CLR   &bt BT_SEL 0   &bt BT_SEL 1  &bt BT_SEL 2  &bt BT_SEL 3  ___             _PASSTHRU_ROW_      
//     ├────────────┼──────────────┼─────────────┼─────────────┼─────────────┼─────────────┤ ├─────────────┼─────────────┼─────────────┼─────────────┼─────────────┼─────────────┤
         _PASSTHRU_ROW_                                                                        _PASSTHRU_ROW_
//     ├────────────┼──────────────┼─────────────┼─────────────┼─────────────┼─────────────┤ ├─────────────┼─────────────┼─────────────┼─────────────┼─────────────┼─────────────┤
         _PASSTHRU_ROW_                                                                        _PASSTHRU_ROW_
//     ╰────────────┼──────────────┼─────────────┴─────────────┼─────────────┼─────────────┤ ├─────────────┼─────────────┼─────────────┼─────────────┴─────────────┴─────────────╯
                                                   _PASSTHRU_THUMBS_                           _PASSTHRU_THUMBS_
//                                               ╰─────────────┴─────────────┴─────────────╯ ╰─────────────┴─────────────┴─────────────╯

)

ZMK_LAYER(Wsp,
//     ╭────────────┬──────────────┬─────────────┬─────────────┬─────────────┬─────────────╮ ╭────────────┬─────────────┬─────────────┬─────────────┬────────────┬───────────╮
         ___           ___           &kp LG(N7)    &kp LG(N8)    &kp LG(N9)    ___             ___          &kp LG(N7)    &kp LG(N8)    &kp LG(N9)    ___          ___            
//     ├────────────┼──────────────┼─────────────┼─────────────┼─────────────┼─────────────┤ ├────────────┼─────────────┼─────────────┼─────────────┼────────────┼───────────┤
         ___           ___           &kp LG(N4)    &kp LG(N5)    &kp LG(N6)    ___             ___          &kp LG(N4)    &kp LG(N5)    &kp LG(N6)    ___          ___          
//     ├────────────┼──────────────┼─────────────┼─────────────┼─────────────┼─────────────┤ ├────────────┼─────────────┼─────────────┼─────────────┼────────────┼───────────┤
         ___           ___           &kp LG(N1)    &kp LG(N2)    &kp LG(N3)    ___             ___          &kp LG(N1)    &kp LG(N2)    &kp LG(N3)    ___          ___          
//     ╰────────────┼──────────────┼─────────────┴─────────────┼─────────────┼─────────────┤ ├────────────┼─────────────┴─────────────┼─────────────┼────────────┼───────────╯
                                                   _PASSTHRU_THUMBS_                           _PASSTHRU_THUMBS_
//                                               ╰─────────────┴─────────────┴─────────────╯ ╰─────────────┴─────────────┴─────────────╯

)

