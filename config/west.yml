## config/west.yml
```yaml
manifest:
  remotes:
    - name: zmkfirmware
      url-base: https://github.com/zmkfirmware
    - name: m165437 # nice!view customization
      url-base: https://github.com/M165437 # nice!view customization
  projects:
    - name: zmk
      remote: zmkfirmware
      revision: main
      import: app/west.yml
    - name: nice-view-gem # nice!view customization
      remote: m165437 
      revision: main 
  self:
    path: config
```
